#include "charybdis_cirque.dtsi"

&default_transform {
    col-offset = <6>;
};

&kscan0 {
    diode-direction = "col2row";
    col-gpios
        = <&pro_micro 4 (GPIO_ACTIVE_HIGH)> // COL0 
        , <&pro_micro 5 (GPIO_ACTIVE_HIGH)> // COL1 
        , <&pro_micro 6 (GPIO_ACTIVE_HIGH)> // COL2 
        , <&pro_micro 7 (GPIO_ACTIVE_HIGH)> // COL3 
	, <&pro_micro 8 (GPIO_ACTIVE_HIGH)> // COL1 
        , <&pro_micro 9 (GPIO_ACTIVE_HIGH)> // COL2 
    ;
    
};



&nice_nano_spi {
    status = "okay";
  sck-pin = <31>;
  mosi-pin = <17>;
  miso-pin = <17>; // same as mosi (3-wire spi)
  cs-gpios = <&gpio0 29 GPIO_ACTIVE_LOW>;
};

&trackball {
    status = "okay";
        irq-gpios = <&gpio0 8  (GPIO_ACTIVE_LOW | GPIO_PULL_UP)>;
};
